## config/boards/shields/macropad4x4/Kconfig.defconfig
```kconfig
# Copyright (c) 2020 The ZMK Contributors
# SPDX-License-Identifier: MIT

if SHIELD_MACROPAD4X4

config ZMK_KEYBOARD_NAME
    default "MacroPad"

endif
```

## config/boards/shields/macropad4x4/Kconfig.shield
```kconfig
# Copyright (c) 2020 The ZMK Contributors
# SPDX-License-Identifier: MIT

config SHIELD_MACROPAD4X4
	def_bool $(shields_list_contains,macropad4x4)
```
